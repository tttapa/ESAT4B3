#include <Serial_Protocol.h>
#include <RunningAverage.h>
#include <FIRFilter.h>
#include <IIRFilter.h>

#define USE_PROTOCOL
// #define LOG_CPU_USAGE
// #define ECG_SENSOR
#define ECG_DATA

const float ECG_samplefreq  = 360;
const unsigned long ECG_interval  = round(1e6 / ECG_samplefreq);

const uint8_t ECG_pin = A4;

const int16_t DC_offset = 250;

const uint16_t threshold = DC_offset + 200;

const uint16_t maxdistance = 360 * 60 / 30; // Min 30 BPM

//const word ECG_data[] PROGMEM = {500, 497, 494, 499, 502, 501, 502, 498, 496, 491, 489, 495, 491,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 511, 511};
const word ECG_data[] PROGMEM = {316, 335, 331, 288, 243, 232, 262, 313, 357, 355, 314, 259, 234,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 307, };
const size_t ECG_len  = sizeof(ECG_data) / sizeof(word);

const float b_notch[] = { 1.39972748302835,  -1.79945496605670, 1.39972748302835 };

const float b_lp[] = { 0.00113722762905776, 0.00568613814528881, 0.0113722762905776,  0.0113722762905776,  0.00568613814528881, 0.00113722762905776 };
const float a_lp[] = { 1, -3.03124451613593, 3.92924380774061,  -2.65660499035499, 0.928185738776705, -0.133188755896548 };

const float b_hp[] = { 1, -1 };
const float a_hp[] = { 1, -0.995 };

FIRFilter notch(b_notch);
IIRFilter lp(b_lp, a_lp);
IIRFilter hp(b_hp, a_hp);

uint8_t messageToSend[2];

RunningAverage<float, 128> CPU_usage_average;

void setup() {
  Serial.begin(115200);
  pinMode(LED_BUILTIN, OUTPUT);
}

void loop() {
#if defined(ECG_SENSOR) || defined(ECG_DATA)
  static uint16_t ECG_index = 0;
  static unsigned long ECG_prevmicros = micros();
  if (!Serial) {
    ECG_prevmicros = micros();
    ECG_index = 0;
  } else if (micros() - ECG_prevmicros >= ECG_interval) {
    unsigned long startTime = micros();
    ECG_prevmicros += ECG_interval;
#ifdef ECG_SENSOR
    int16_t value = analogRead(ECG_pin);
#elif defined(ECG_DATA)
    int16_t value = pgm_read_word_near(ECG_data + ECG_index);
    ECG_index = (ECG_index + 1) % ECG_len;
#endif
    float filteredf = notch.filter(lp.filter(hp.filter(value - DC_offset)));
    int16_t filtered = round(filteredf) + DC_offset;
    int distance = getPeakDistance(filtered);
    int BPM = 0;
    if (distance == -1) {
      BPM = -300; // Patient is dead
    } else if (distance) {
      BPM = 60 * 360 / distance;
    }
#ifdef USE_PROTOCOL
    send(filtered, ECG);
#else
#ifdef LOG_CPU_USAGE
    // encode(messageToSend, filtered, ECG);
    float CPU_usage = CPU_usage_average.add(float(micros() - startTime) * 100.0 / ECG_interval);
    Serial.print(CPU_usage);
    Serial.print('\t');
#endif
    Serial.print(filtered);
    Serial.print('\t');
    Serial.print(value);
    Serial.print('\t');
    Serial.print(BPM);

    Serial.println();
    Serial.flush();
#endif
  }
#endif
}

int getPeakDistance(uint16_t value) {
  static unsigned int ctr, prevCtr = 0;
  static uint16_t max = 0;

  int distance = 0;
  if (prevCtr > 0)
    prevCtr++;

  if (max > 0) {
    if (value >= max) { // New maximum
      ctr = 0;
      max = value;
      digitalWrite(LED_BUILTIN, HIGH);
    } else if (value < threshold) { // End of peak
      ctr++;
      if (prevCtr > 0) // there was a previous peak
        distance = prevCtr - ctr; // calculate the difference from the previous peak
      prevCtr = ctr;
      max = 0;
      digitalWrite(LED_BUILTIN, LOW);
    } else {
      ctr++;
      digitalWrite(LED_BUILTIN, LOW);
    }
  } else if (prevCtr >= maxdistance) { // Previous peak was too long ago, forget it
    prevCtr = 0;
    distance = -1;
  } else if (value >= threshold) {
    ctr = 0;
    max = value;
  }
  return distance;
}

