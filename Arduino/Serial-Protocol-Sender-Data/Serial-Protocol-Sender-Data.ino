#include "Serial_Protocol.h"

#define USE_PROTOCOL
// #define PRES_SENSOR
const word ECG_data[] PROGMEM = { 483, 482, 484, 483, 482, 481, 480, 479, 476, 474, 474, 472, 467,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 491, 490 };
// noisy // const word ECG_data[] PROGMEM = { 499, 495, 495, 498, 499, 503, 502, 497, 492, 488, 491, 491, 491,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 511, 508 };
const size_t ECG_len  = sizeof(ECG_data) / sizeof(uint16_t);

const word PPG_data[] PROGMEM = { 469, 510, 552, 593, 593, 593, 593, 655, 716, 778, 806, 835, 864,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 473, 473 };
const size_t PPG_len  = sizeof(PPG_data) / sizeof(uint16_t);

const float ECG_samplefreq  = 360;
const float Pres_samplefreq = 50;
const float PPG_samplefreq  = 300;

void setup() {
  Serial.begin(1000000);
}

const unsigned long ECG_interval  = round(1e6 / ECG_samplefreq);
const unsigned long Pres_interval = round(1e6 / Pres_samplefreq);
const unsigned long PPG_interval  = round(1e6 / PPG_samplefreq);

void loop() {
  static uint16_t ECG_index = 0;
  static unsigned long ECG_prevmicros = micros();
  if (!Serial) {
    ECG_prevmicros = micros();
    ECG_index = 0;
  } else if (micros() - ECG_prevmicros >= ECG_interval) {
    uint16_t value = pgm_read_word_near(ECG_data + ECG_index);
#ifdef USE_PROTOCOL
    send(value, ECG);
#else
    Serial.println(value);
#endif
    ECG_index = (ECG_index + 1) % ECG_len;
    ECG_prevmicros += ECG_interval;
  }

  static uint8_t counter = 0;
  static unsigned long Pres_prevmicros = micros();
  if (!Serial) {
    Pres_prevmicros = micros();
  } else if (micros() - Pres_prevmicros >= Pres_interval) {
#ifdef PRES_SENSOR
    uint16_t value = analogRead(A0);
#else
    uint16_t value = (counter++) << 2;
#endif
#ifdef USE_PROTOCOL
    send(value, PRESSURE_A);
#else
    Serial.println(value);
#endif
    Pres_prevmicros += Pres_interval;
  }


  static uint16_t PPG_index = 0;
  static unsigned long PPG_prevmicros = micros();
  if (!Serial) {
    PPG_prevmicros = micros();
    PPG_index = 0;
  } else if (micros() - PPG_prevmicros >= PPG_interval) {
    uint16_t value = pgm_read_word_near(PPG_data + PPG_index);
#ifdef USE_PROTOCOL
    send(value, PPG_RED);
    send(value * 9 / 10 + 1023 / 10, PPG_IR);
#else
    Serial.println(value);
#endif
    PPG_index = (PPG_index + 1) % PPG_len;
    PPG_prevmicros += PPG_interval;
  }
}

